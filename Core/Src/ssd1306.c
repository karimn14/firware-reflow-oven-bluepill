#include "ssd1306.h"

#include <string.h>

#define SSD1306_COMMAND_CONTROL 0x00U
#define SSD1306_DATA_CONTROL    0x40U
#define SSD1306_I2C_TIMEOUT_MS  100U

/* Printable ASCII, 5 columns per glyph, least-significant bit at the top. */
static const uint8_t font_5x7[96][5] = {
  {0x00,0x00,0x00,0x00,0x00},{0x00,0x00,0x5f,0x00,0x00},{0x00,0x07,0x00,0x07,0x00},{0x14,0x7f,0x14,0x7f,0x14},
  {0x24,0x2a,0x7f,0x2a,0x12},{0x23,0x13,0x08,0x64,0x62},{0x36,0x49,0x55,0x22,0x50},{0x00,0x05,0x03,0x00,0x00},
  {0x00,0x1c,0x22,0x41,0x00},{0x00,0x41,0x22,0x1c,0x00},{0x14,0x08,0x3e,0x08,0x14},{0x08,0x08,0x3e,0x08,0x08},
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  {0x00,0x00,0x7f,0x00,0x00},{0x00,0x41,0x36,0x08,0x00},{0x10,0x08,0x08,0x10,0x08},{0x00,0x06,0x09,0x09,0x06}
};

static HAL_StatusTypeDef write_commands(SSD1306_HandleTypeDef *display,
                                        const uint8_t *commands,
                                        uint16_t length)
{
  return HAL_I2C_Mem_Write(display->i2c, display->address,
                           SSD1306_COMMAND_CONTROL, I2C_MEMADD_SIZE_8BIT,
                           (uint8_t *)commands, length,
                           SSD1306_I2C_TIMEOUT_MS);
}

HAL_StatusTypeDef SSD1306_Init(SSD1306_HandleTypeDef *display,
                              I2C_HandleTypeDef *i2c,
                              uint8_t address_7bit)
{
  static const uint8_t init_commands[] = {
    0xae, 0x20, 0x00, 0xb0, 0xc8, 0x00, 0x10, 0x40,
    0x81, 0x7f, 0xa1, 0xa6, 0xa8, 0x3f, 0xa4, 0xd3,
    0x00, 0xd5, 0x80, 0xd9, 0xf1, 0xda, 0x12, 0xdb,
    0x40, 0x8d, 0x14, 0xaf
  };

  if ((display == NULL) || (i2c == NULL))
  {
    return HAL_ERROR;
  }

  display->i2c = i2c;
  display->address = (uint16_t)(address_7bit << 1U);
  SSD1306_Clear(display);

  if (HAL_I2C_IsDeviceReady(i2c, display->address, 2U,
                            SSD1306_I2C_TIMEOUT_MS) != HAL_OK)
  {
    return HAL_ERROR;
  }

  if (write_commands(display, init_commands, sizeof(init_commands)) != HAL_OK)
  {
    return HAL_ERROR;
  }

  return SSD1306_Update(display);
}

void SSD1306_Clear(SSD1306_HandleTypeDef *display)
{
  if (display != NULL)
  {
    memset(display->buffer, 0, sizeof(display->buffer));
  }
}

void SSD1306_DrawString(SSD1306_HandleTypeDef *display,
                       uint8_t x,
                       uint8_t row,
                       const char *text)
{
  uint16_t index;

  if ((display == NULL) || (text == NULL) || (row >= 8U))
  {
    return;
  }

  index = (uint16_t)row * SSD1306_WIDTH + x;
  while ((*text != '\0') && ((index + 5U) < sizeof(display->buffer)))
  {
    uint8_t character = (uint8_t)*text++;
    if ((character < 32U) || (character > 127U))
    {
      character = (uint8_t)'?';
    }

    memcpy(&display->buffer[index], font_5x7[character - 32U], 5U);
    display->buffer[index + 5U] = 0x00U;
    index += 6U;

    if ((index / SSD1306_WIDTH) != row)
    {
      break;
    }
  }
}

HAL_StatusTypeDef SSD1306_Update(SSD1306_HandleTypeDef *display)
{
  for (uint8_t page = 0U; page < 8U; ++page)
  {
    const uint8_t commands[] = {(uint8_t)(0xb0U + page), 0x00U, 0x10U};
    if (write_commands(display, commands, sizeof(commands)) != HAL_OK)
    {
      return HAL_ERROR;
    }

    if (HAL_I2C_Mem_Write(display->i2c, display->address,
                          SSD1306_DATA_CONTROL, I2C_MEMADD_SIZE_8BIT,
                          &display->buffer[(uint16_t)page * SSD1306_WIDTH],
                          SSD1306_WIDTH, SSD1306_I2C_TIMEOUT_MS) != HAL_OK)
    {
      return HAL_ERROR;
    }
  }

  return HAL_OK;
}
